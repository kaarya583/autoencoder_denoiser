## firmware/esp32_benchmark/main/Kconfig.projbuild
```kconfig
menu "ESP32 denoiser benchmark"

config EDN_FREQUENCY_MODEL
    bool "Benchmark the frequency U-Net EDNFQ8 model"
    default n
    help
        Select the frequency model's full 257-bin complex frontend and graph.
        main/model.bin must contain EDNFQ8-v1. When disabled it must contain
        the global spectral TCN's EDNSI8-v2 model. A mismatch stops at init.

config EDN_MODEL_IN_INTERNAL_SRAM
    bool "Copy the model from flash to internal SRAM"
    default n
    help
        Allocate a 16-byte-aligned, byte-addressable internal SRAM buffer and
        copy the complete deployed model into it before initialization.
        Allocation failure stops the benchmark; it never falls back to flash.
        Keep disabled for the default flash-mapped model placement. Compare
        both settings on the same board and model to measure the tradeoff.

endmenu
```

## output/esp32/firmware_build/gtcrn_s3_champion_20260914/source_snapshot/firmware/gtcrn_benchmark/sdkconfig.defaults
```kconfig
CONFIG_ESP_DEFAULT_CPU_FREQ_MHZ_240=y
CONFIG_FREERTOS_HZ=1000
CONFIG_ESP_MAIN_TASK_STACK_SIZE=8192
CONFIG_COMPILER_OPTIMIZATION_PERF=y
CONFIG_DSP_OPTIMIZED=y
CONFIG_DSP_MAX_FFT_SIZE_512=y
# CONFIG_SPIRAM is not set
```

## output/esp32/firmware_build/gtcrn_s3_graph/source_snapshot/firmware/gtcrn_benchmark/main/Kconfig.projbuild
```kconfig
menu "GTCRN benchmark"
    config GTCRN_MODEL_IN_INTERNAL_SRAM
        bool "Copy packed model from mapped flash into internal SRAM"
        default n
        help
            Compare model placement with identical weights. The default
            executes with model constants in mapped flash and no PSRAM.
endmenu
```

## output/esp32/firmware_build/trained_baseline_shared_kernels/source_snapshot/firmware/esp32_denoiser/Kconfig
```kconfig
menu "Integer denoiser kernels"

config EDN_S3_SIMD_DOT
    bool "Use ESP32-S3 signed INT8 SIMD dot products"
    depends on IDF_TARGET_ESP32S3
    default n
    help
        Accelerate supported dense rows with pinned ESP-NN assembly while
        preserving the portable runtime's exact requantization. Alignment,
        readable guards, and scalar tails are handled by the adapter.
        The benchmark executes a known-answer self-test before measuring.
        Disabled by default until verified on the intended physical board.

endmenu
```
